## CMakeLists.txt
```
# NudgeBand firmware (Zephyr / nRF Connect SDK application)
# SPDX-License-Identifier: MIT
cmake_minimum_required(VERSION 3.20.0)

# The NudgeBand board definition lives in this repo (boards/nudgeband).
list(APPEND BOARD_ROOT ${CMAKE_CURRENT_SOURCE_DIR})
list(APPEND DTS_ROOT ${CMAKE_CURRENT_SOURCE_DIR})

find_package(Zephyr REQUIRED HINTS $ENV{ZEPHYR_BASE})
project(nudgeband)

target_sources(app PRIVATE
	src/main.c
	src/board_io.c
	src/accel.c
	src/haptics.c
	src/led.c
	src/pmic.c
	src/ble.c
	# hardware-independent, also built by tests/host
	src/activity.c
	src/smartwake.c
	src/alarm.c
	src/protocol.c
	src/battery.c
)
```

## prj.conf
```kconfig
# NudgeBand firmware configuration
CONFIG_GPIO=y
CONFIG_I2C=y

# Logs over SEGGER RTT through the dock's SWD pins (no UART on the band)
CONFIG_LOG=y
CONFIG_USE_SEGGER_RTT=y
CONFIG_LOG_BACKEND_RTT=y
CONFIG_LOG_BACKEND_UART=n
CONFIG_CONSOLE=y
CONFIG_RTT_CONSOLE=y
CONFIG_UART_CONSOLE=n

# Bluetooth peripheral (docs/ble-protocol.md)
CONFIG_BT=y
CONFIG_BT_PERIPHERAL=y
CONFIG_BT_DEVICE_NAME="NudgeBand"
CONFIG_BT_DEVICE_NAME_DYNAMIC=y
CONFIG_BT_SMP=y
CONFIG_BT_BONDABLE=y
CONFIG_BT_MAX_PAIRED=1
CONFIG_BT_MAX_CONN=1
CONFIG_BT_GATT_DYNAMIC_DB=n
CONFIG_BT_BAS=y
CONFIG_BT_DIS=y
CONFIG_BT_DIS_MODEL="NudgeBand"
CONFIG_BT_DIS_MANUF="NudgeBand project"
CONFIG_BT_DIS_HW_REV=y
CONFIG_BT_DIS_HW_REV_STR="rev C"
CONFIG_BT_DIS_FW_REV=y
CONFIG_BT_DIS_FW_REV_STR="0.4"

# Bonds survive a reset (settings in RRAM)
CONFIG_FLASH=y
CONFIG_FLASH_MAP=y
CONFIG_ZMS=y
CONFIG_SETTINGS=y
CONFIG_BT_SETTINGS=y

CONFIG_MAIN_STACK_SIZE=2048
```

## src/main.c
```c
/*
 * NudgeBand firmware: track movement all night, wake the wearer gently in light sleep inside the
 * window before the alarm. Status of every part: ../TODO.md.
 */
#include <zephyr/kernel.h>
#include <zephyr/bluetooth/services/bas.h>
#include <zephyr/logging/log.h>

#include "accel.h"
#include "activity.h"
#include "alarm.h"
#include "band.h"
#include "ble.h"
#include "battery.h"
#include "board_io.h"
#include "haptics.h"
#include "led.h"
#include "pmic.h"
#include "smartwake.h"

LOG_MODULE_REGISTER(main, LOG_LEVEL_INF);

#define EPOCH_S 30

static K_MUTEX_DEFINE(lock);
static K_SEM_DEFINE(fifo_ready, 0, 1);

/* Time: UTC at the moment the phone set it, plus uptime since then. */
static uint32_t utc_at_set;
static int64_t uptime_at_set_ms;
static int16_t tz_offset_min;
static bool time_set;

static struct nb_alarm_cfg alarm_cfg;
static uint32_t next_alarm_utc;
static enum nb_state state = NB_STATE_IDLE;
static uint8_t repeats_left;
static enum nb_wake_reason last_wake_reason;
static uint32_t last_wake_utc;

static struct smartwake sw;
static struct activity_acc acc;

static void repeat_fn(struct k_work *w);
static K_WORK_DELAYABLE_DEFINE(repeat_work, repeat_fn);

uint32_t band_now_utc(void)
{
	if (!time_set) {
		return 0;
	}
	return utc_at_set + (uint32_t)((k_uptime_get() - uptime_at_set_ms) / 1000);
}

static void rearm_locked(void)
{
	struct smartwake_cfg cfg;
	uint32_t now = band_now_utc();

	next_alarm_utc = now ? alarm_next_utc(&alarm_cfg, now, tz_offset_min) : 0;
	if (!next_alarm_utc) {
		smartwake_disarm(&sw);
		state = NB_STATE_IDLE;
		return;
	}
	smartwake_default_cfg(&cfg);
	cfg.epoch_s = EPOCH_S;
	cfg.window_s = (alarm_cfg.flags & NB_ALARM_FLAG_SMARTWAKE) ? alarm_cfg.window_min * 60u : 0;
	smartwake_arm(&sw, &cfg, next_alarm_utc);
	state = NB_STATE_TRACKING;
	LOG_INF("next alarm at %u (UTC), window %u min", next_alarm_utc, cfg.window_s / 60);
}

void band_set_time(const struct nb_time *t)
{
	k_mutex_lock(&lock, K_FOREVER);
	utc_at_set = t->utc;
	uptime_at_set_ms = k_uptime_get();
	tz_offset_min = t->tz_offset_min;
	time_set = true;
	if (state == NB_STATE_IDLE || state == NB_STATE_TRACKING) {
		rearm_locked();
	}
	k_mutex_unlock(&lock);
	ble_status_changed();
}

void band_get_time(struct nb_time *t)
{
	t->utc = band_now_utc();
	t->tz_offset_min = tz_offset_min;
	t->reserved = 0;
}

void band_get_alarm(struct nb_alarm_cfg *cfg)
{
	k_mutex_lock(&lock, K_FOREVER);
	*cfg = alarm_cfg;
	k_mutex_unlock(&lock);
}

void band_set_alarm(const struct nb_alarm_cfg *cfg)
{
	k_mutex_lock(&lock, K_FOREVER);
	alarm_cfg = *cfg;
	/* TODO(TODO.md 3.5): keep the alarm in flash (settings) so a reset doesn't lose it. */
	if (state != NB_STATE_WAKING && state != NB_STATE_WAIT_REPEAT) {
		rearm_locked();
	}
	k_mutex_unlock(&lock);
	ble_status_changed();
}

void band_get_status(struct nb_status *st)
{
	k_mutex_lock(&lock, K_FOREVER);
	st->version = NB_STATUS_VERSION;
	st->state = state;
	st->battery_pct = pmic_battery_pct();
	st->flags = (pmic_docked() ? NB_FLAG_DOCKED : 0) | (pmic_charging() ? NB_FLAG_CHARGING : 0) |
		    (time_set ? NB_FLAG_TIME_SET : 0) | (next_alarm_utc ? NB_FLAG_ALARM_ARMED : 0) |
		    (sw.n ? NB_FLAG_LOG_HAS_DATA : 0);
	st->next_alarm_utc = next_alarm_utc;
	st->fw_major = FW_MAJOR;
	st->fw_minor = FW_MINOR;
	st->last_wake_reason = last_wake_reason;
	st->reserved = 0;
	st->last_wake_utc = last_wake_utc;
	st->stored_epochs = sw.n; /* RAM only for now (TODO.md 3.4) */
	k_mutex_unlock(&lock);
}

static void buzz_locked(void)
{
	(void)haptics_start(alarm_cfg.intensity, alarm_cfg.pattern, alarm_cfg.ramp_s,
			    alarm_cfg.buzz_s);
	state = NB_STATE_WAKING;
	/* After the buzz, wait repeat_min, then buzz again (until dismissed or out of repeats). */
	k_work_reschedule(&repeat_work, K_SECONDS(alarm_cfg.buzz_s));
}

static void repeat_fn(struct k_work *w)
{
	ARG_UNUSED(w);
	k_mutex_lock(&lock, K_FOREVER);
	if (state == NB_STATE_WAKING) {
		if (repeats_left == 0 || alarm_cfg.repeat_min == 0) {
			rearm_locked(); /* done: on to the next alarm */
		} else {
			repeats_left--;
			state = NB_STATE_WAIT_REPEAT;
			k_work_reschedule(&repeat_work, K_MINUTES(alarm_cfg.repeat_min));
		}
	} else if (state == NB_STATE_WAIT_REPEAT) {
		buzz_locked();
	}
	k_mutex_unlock(&lock);
	ble_status_changed();
}

static void wake_locked(enum nb_wake_reason why)
{
	last_wake_reason = why;
	last_wake_utc = band_now_utc();
	repeats_left = alarm_cfg.max_repeats;
	smartwake_disarm(&sw);
	LOG_INF("wake: reason %d", why);
	buzz_locked();
}

enum nb_cp_result band_test_buzz(uint8_t intensity, uint8_t seconds)
{
	/* intensity is the motor drive 0-255, the same scale as the alarm's (docs/ble-protocol.md). */
	if (seconds < 1 || seconds > 10) {
		return NB_CP_INVALID;
	}
	if (state == NB_STATE_WAKING) {
		return NB_CP_BUSY;
	}
	LOG_INF("test buzz: drive %u for %u s", intensity, seconds);
	return haptics_start(intensity, 0, 1, seconds) ? NB_CP_BUSY : NB_CP_OK;
}

void band_stop_buzz(void)
{
	haptics_stop();
}

void band_dismiss(void)
{
	k_mutex_lock(&lock, K_FOREVER);
	haptics_stop();
	k_work_cancel_delayable(&repeat_work);
	if (state == NB_STATE_WAKING || state == NB_STATE_WAIT_REPEAT ||
	    state == NB_STATE_IN_WINDOW) {
		/* TODO(TODO.md 3.3): dismissing during the window should skip today's alarm only. */
		rearm_locked();
	}
	k_mutex_unlock(&lock);
	ble_status_changed();
}

/* IDENTIFY: blink the LED blue twice (on 250 ms, off 250 ms) from a work item, so the Bluetooth
 * thread isn't held while the LED is lit. */
static void identify_fn(struct k_work *w);
static K_WORK_DELAYABLE_DEFINE(identify_work, identify_fn);
static uint8_t identify_step;

static void identify_fn(struct k_work *w)
{
	ARG_UNUSED(w);
	bool on = (identify_step % 2) == 0;

	(void)led_set(0, 0, on ? 128 : 0);
	if (++identify_step < 4) {
		k_work_reschedule(&identify_work, K_MSEC(250));
	}
}

void band_identify(void)
{
	LOG_INF("identify: blink LED");
	identify_step = 0;
	k_work_reschedule(&identify_work, K_NO_WAIT);
}

/* Called once per epoch with that epoch's activity. */
static void end_of_epoch(uint16_t activity)
{
	enum smartwake_result r;
	uint32_t now;
	bool changed = false;

	k_mutex_lock(&lock, K_FOREVER);
	now = band_now_utc();
	r = now ? smartwake_feed(&sw, now, activity) : SMARTWAKE_NONE;
	if (state == NB_STATE_TRACKING && sw.armed && now + sw.cfg.window_s >= sw.alarm_s) {
		state = NB_STATE_IN_WINDOW;
		changed = true;
	}
	if (r == SMARTWAKE_LIGHT_SLEEP) {
		wake_locked(NB_WAKE_LIGHT_SLEEP);
		changed = true;
	} else if (r == SMARTWAKE_DEADLINE) {
		wake_locked((alarm_cfg.flags & NB_ALARM_FLAG_SMARTWAKE) ? NB_WAKE_DEADLINE
									 : NB_WAKE_EXACT);
		changed = true;
	}
	k_mutex_unlock(&lock);
	if (changed) {
		ble_status_changed();
	}
}

/* Battery and dock state: refresh, push to the Battery service, notify Status on a change. */
#define BATTERY_EVERY_EPOCHS 4 /* 2 min */

static void battery_refresh(void)
{
	static uint8_t last_pct = BATTERY_PCT_UNKNOWN;
	static bool last_docked, last_charging;
	uint8_t pct;
	bool docked, charging_now;

	(void)pmic_update();
	pct = pmic_battery_pct();
	docked = pmic_docked();
	charging_now = pmic_charging();
	if (pct <= 100) {
		(void)bt_bas_set_battery_level(pct);
	}
	if (pct != last_pct || docked != last_docked || charging_now != last_charging) {
		last_pct = pct;
		last_docked = docked;
		last_charging = charging_now;
		ble_status_changed();
	}
}

static struct gpio_callback acc_cb;

static void acc_int1_isr(const struct device *dev, struct gpio_callback *cb, uint32_t pins)
{
	k_sem_give(&fifo_ready);
}

int main(void)
{
	static struct accel_sample batch[32];
	int64_t epoch_end_ms;
	int err;

	LOG_INF("NudgeBand firmware %d.%d", FW_MAJOR, FW_MINOR);

	nb_alarm_cfg_default(&alarm_cfg);
	err = board_io_init();
	if (err) {
		LOG_ERR("board_io_init failed (%d)", err);
		return 0;
	}
	(void)pmic_init();
	(void)led_init();
	(void)haptics_init();
	err = accel_init();
	(void)ble_init();
	battery_refresh();

	if (err == 0) {
		gpio_pin_interrupt_configure_dt(&io_acc_int1, GPIO_INT_EDGE_TO_ACTIVE);
		gpio_init_callback(&acc_cb, acc_int1_isr, BIT(io_acc_int1.pin));
		gpio_add_callback_dt(&io_acc_int1, &acc_cb);
		activity_reset(&acc);
		(void)accel_start();
	}

	epoch_end_ms = k_uptime_get() + EPOCH_S * 1000;
	uint32_t epochs = 0;

	for (;;) {
		/* The FIFO interrupt normally wakes us every 2 s; the timeout covers a missed one. */
		(void)k_sem_take(&fifo_ready, K_SECONDS(3));

		int n = accel_read_fifo(batch, ARRAY_SIZE(batch));

		if (n > 0) {
			activity_add(&acc, batch, (uint32_t)n);
		}
		/* TODO(TODO.md 3.1): mark epochs as "no data" (0xFFFF) while docked or off the wrist. */
		while (k_uptime_get() >= epoch_end_ms) {
			end_of_epoch(activity_end_epoch(&acc));
			epoch_end_ms += EPOCH_S * 1000;
			if (++epochs % BATTERY_EVERY_EPOCHS == 0) {
				battery_refresh();
			}
		}
	}
	return 0;
}
```

## src/band.h
```c
/* The band's shared state and the actions the Bluetooth service can ask for (main.c). */
#ifndef NUDGEBAND_BAND_H
#define NUDGEBAND_BAND_H

#include <stdbool.h>
#include <stdint.h>

#include "protocol.h"

#define FW_MAJOR 0
#define FW_MINOR 4

/* UTC now, or 0 if the phone has not set the time since power-up. */
uint32_t band_now_utc(void);

void band_set_time(const struct nb_time *t);
void band_get_time(struct nb_time *t);

void band_get_alarm(struct nb_alarm_cfg *cfg);
void band_set_alarm(const struct nb_alarm_cfg *cfg); /* already validated */

void band_get_status(struct nb_status *st);

enum nb_cp_result band_test_buzz(uint8_t intensity, uint8_t seconds);
void band_stop_buzz(void);
void band_dismiss(void);
void band_identify(void);

#endif
```

## src/battery.c
```c
#include "battery.h"

#include <stddef.h>

uint16_t battery_vbmon_to_mv(uint8_t vbmon_reg, uint16_t vbatreg_mv)
{
	/* Bits 6:5 range (60/70/80/90 % of VBATREG), bits 4:2 threshold above the range floor. */
	static const uint8_t th_pct[8] = {0, 0, 2, 4, 4, 6, 6, 8};
	uint8_t range = (vbmon_reg >> 5) & 0x3;
	uint8_t th = (vbmon_reg >> 2) & 0x7;
	uint32_t pct_x10;

	if (th == 0) {
		/* Nothing found in this range. In the lowest range that means below 60 % of
		 * VBATREG (about 2.5 V): call it empty. Elsewhere the reading is incomplete. */
		return range == 0 ? (uint16_t)(vbatreg_mv * 60u / 100u) : 0;
	}
	/* Middle of the 2 % step the reading falls in. */
	pct_x10 = (60u + 10u * range + th_pct[th]) * 10u + 10u;
	return (uint16_t)(vbatreg_mv * pct_x10 / 1000u);
}

uint16_t battery_vbreg_to_mv(uint8_t reg05)
{
	uint16_t mv = 3600u + 10u * (reg05 >> 1);

	return mv > 4650u ? 4650u : mv;
}

uint8_t battery_mv_to_pct(uint16_t mv)
{
	/* Typical small LiPo discharge curve at light load. */
	static const struct {
		uint16_t mv;
		uint8_t pct;
	} curve[] = {
		{3300, 0}, {3500, 5}, {3600, 10}, {3700, 25}, {3750, 40}, {3800, 52},
		{3850, 62}, {3900, 70}, {4000, 82}, {4100, 92}, {4180, 100},
	};
	size_t n = sizeof(curve) / sizeof(curve[0]);

	if (mv <= curve[0].mv) {
		return 0;
	}
	for (size_t i = 1; i < n; i++) {
		if (mv <= curve[i].mv) {
			uint32_t span = curve[i].mv - curve[i - 1].mv;
			uint32_t pos = mv - curve[i - 1].mv;

			return (uint8_t)(curve[i - 1].pct +
					 (curve[i].pct - curve[i - 1].pct) * pos / span);
		}
	}
	return 100;
}
```

## src/battery.h
```c
/*
 * Battery level from the BQ25125's VBMON reading (hardware-independent, host-tested).
 * VBMON gives the battery voltage as a fraction of VBATREG in 2 % steps from 60 % to 100 %.
 */
#ifndef NUDGEBAND_BATTERY_H
#define NUDGEBAND_BATTERY_H

#include <stdint.h>

#define BATTERY_PCT_UNKNOWN 0xFF

/* Battery voltage in mV from VBMON register 0x0A and VBATREG (mV); 0 if the reading is empty. */
uint16_t battery_vbmon_to_mv(uint8_t vbmon_reg, uint16_t vbatreg_mv);

/* VBATREG in mV from register 0x05 (3.6 V + 10 mV per step in bits 7:1). */
uint16_t battery_vbreg_to_mv(uint8_t reg05);

/* Rough state of charge (0-100) of a 4.2 V LiPo cell at rest. */
uint8_t battery_mv_to_pct(uint16_t mv);

#endif
```

## src/haptics.c
```c
/*
 * DRV2605L register-level driver (TI SLOS854). The motor is driven in real-time playback (RTP)
 * mode so the firmware can ramp the strength itself. EN is held low between buzzes (shutdown).
 * Motor: Vybronics VG0832012 LRA (1.8 Vrms, 235 Hz). Auto-calibrated once at boot.
 */
#include "haptics.h"

#include <zephyr/kernel.h>
#include <zephyr/logging/log.h>

#include "board_io.h"

LOG_MODULE_REGISTER(haptics, LOG_LEVEL_INF);

#define ADDR 0x5A

#define REG_STATUS    0x00
#define REG_MODE      0x01
#define REG_RTP       0x02
#define REG_LIBRARY   0x03
#define REG_GO        0x0C
#define REG_RATED_V   0x16
#define REG_OD_CLAMP  0x17
#define REG_CAL_COMP  0x18
#define REG_CAL_BEMF  0x19
#define REG_FEEDBACK  0x1A
#define REG_CONTROL1  0x1B
#define REG_CONTROL3  0x1D
#define REG_CONTROL4  0x1E
#define REG_OL_PERIOD 0x20

#define MODE_RTP          0x05
#define MODE_AUTOCAL      0x07
#define MODE_STANDBY      BIT(6)
#define LIBRARY_LRA       0x06
#define STATUS_DIAG_FAIL  BIT(3)

/*
 * VG0832012 LRA: 1.8 Vrms rated (1.85 max), 235 Hz. With SAMPLE_TIME 300 us:
 * RATED_VOLTAGE = 1.8 * sqrt(1 - (4 * 300 us + 300 us) * 235 Hz) / 20.58 mV = 70.
 * OD_CLAMP 0x7A is about 2.6 V peak (the motor's 1.85 Vrms max as a sine peak).
 * DRIVE_TIME: half a period (2.13 ms) = 0.5 ms + 0.1 ms * 16.
 * Open-loop fallback period: 1 / (235 Hz * 98.46 us) = 43.
 */
#define LRA_RATED_V   70
#define LRA_OD_CLAMP  0x7A
#define LRA_CONTROL1  (0x80 | 16)     /* STARTUP_BOOST, DRIVE_TIME 16 */
#define LRA_FEEDBACK  0xAA            /* LRA, brake factor 2, loop gain 2, BEMF gain 2 */
#define LRA_CONTROL4  0x30            /* AUTO_CAL_TIME 3 (longest) */
#define LRA_OL_PERIOD 43
/* Control3: NG_THRESH and ERM_OPEN_LOOP at their defaults (0xA0), RTP data unsigned (bit 3),
 * bit 0 LRA_OPEN_LOOP when calibration failed. */
#define CONTROL3_BASE 0xA8
#define CONTROL3_LRA_OPEN_LOOP BIT(0)

#define STEP_MS 50

static struct k_work_delayable step_work;
static uint32_t elapsed_ms;
static uint32_t ramp_ms;
static uint32_t total_ms;
static uint8_t target;
static uint8_t pat;
static bool running;

static int wr(uint8_t reg, uint8_t val)
{
	return i2c_reg_write_byte(i2c_bus, ADDR, reg, val);
}

static bool found; /* answered on I2C (needs VBAT) */
static bool calibrated;
static uint8_t cal_comp, cal_bemf, cal_feedback = LRA_FEEDBACK;

/* Write the motor settings (and calibration results, if any). EN must be high. */
static int configure(bool open_loop)
{
	int err;

	err = wr(REG_FEEDBACK, cal_feedback);
	err = err ?: wr(REG_RATED_V, LRA_RATED_V);
	err = err ?: wr(REG_OD_CLAMP, LRA_OD_CLAMP);
	err = err ?: wr(REG_CONTROL1, LRA_CONTROL1);
	err = err ?: wr(REG_CONTROL4, LRA_CONTROL4);
	err = err ?: wr(REG_OL_PERIOD, LRA_OL_PERIOD);
	err = err ?: wr(REG_LIBRARY, LIBRARY_LRA);
	if (calibrated) {
		err = err ?: wr(REG_CAL_COMP, cal_comp);
		err = err ?: wr(REG_CAL_BEMF, cal_bemf);
	}
	err = err ?: wr(REG_CONTROL3, CONTROL3_BASE | (open_loop ? CONTROL3_LRA_OPEN_LOOP : 0));
	return err;
}

/* Auto-calibration (a short buzz at boot). Without it the closed loop has no back-EMF gain to
 * work with, so on failure the driver runs the motor open loop at its 235 Hz instead. */
static void calibrate(void)
{
	uint8_t go = 1, st = 0;
	int err;

	calibrated = false;
	err = configure(false);
	err = err ?: wr(REG_MODE, MODE_AUTOCAL);
	err = err ?: wr(REG_GO, 1);
	for (int i = 0; !err && go && i < 300; i++) {
		k_msleep(10);
		err = i2c_reg_read_byte(i2c_bus, ADDR, REG_GO, &go);
		go &= 1;
	}
	err = err ?: i2c_reg_read_byte(i2c_bus, ADDR, REG_STATUS, &st);
	if (err || go || (st & STATUS_DIAG_FAIL)) {
		LOG_WRN("auto-calibration failed (err %d, go %u, status 0x%02x): open loop", err, go,
			st);
		(void)wr(REG_GO, 0);
		return;
	}
	(void)i2c_reg_read_byte(i2c_bus, ADDR, REG_CAL_COMP, &cal_comp);
	(void)i2c_reg_read_byte(i2c_bus, ADDR, REG_CAL_BEMF, &cal_bemf);
	(void)i2c_reg_read_byte(i2c_bus, ADDR, REG_FEEDBACK, &cal_feedback);
	calibrated = true;
	LOG_INF("calibrated: comp 0x%02x, bemf 0x%02x, feedback 0x%02x", cal_comp, cal_bemf,
		cal_feedback);
}

/* Strength at this moment of the pattern, 0-255. */
static uint8_t level_now(void)
{
	uint32_t lvl = target;

	if (elapsed_ms < ramp_ms) {
		lvl = lvl * elapsed_ms / ramp_ms;
	}
	switch (pat) {
	case 1: /* slow pulses: 1 s on, 1 s off */
		return (elapsed_ms / 1000) % 2 ? 0 : (uint8_t)lvl;
	case 2: /* heartbeat: two short beats every 1.2 s */
	{
		uint32_t t = elapsed_ms % 1200;

		return (t < 150 || (t >= 300 && t < 450)) ? (uint8_t)lvl : 0;
	}
	default:
		return (uint8_t)lvl;
	}
}

static void power_down(void)
{
	(void)wr(REG_RTP, 0);
	(void)wr(REG_MODE, MODE_STANDBY);
	gpio_pin_set_dt(&io_hapt_en, 0);
	running = false;
}

static void step(struct k_work *work)
{
	ARG_UNUSED(work);
	if (!running) {
		return;
	}
	if (elapsed_ms >= total_ms) {
		power_down();
		return;
	}
	int err = wr(REG_RTP, level_now());

	if (err) {
		LOG_WRN("RTP write failed (%d)", err);
	}
	elapsed_ms += STEP_MS;
	k_work_reschedule(&step_work, K_MSEC(STEP_MS));
}

int haptics_init(void)
{
	uint8_t st;
	int err;

	k_work_init_delayable(&step_work, step);

	gpio_pin_set_dt(&io_hapt_en, 1);
	k_msleep(1);
	err = i2c_reg_read_byte(i2c_bus, ADDR, REG_STATUS, &st);
	if (err) {
		LOG_ERR("no answer at 0x%02x (%d): no VBAT (flat or cut-off cell)?", ADDR, err);
		gpio_pin_set_dt(&io_hapt_en, 0);
		return err;
	}
	LOG_INF("DRV2605L status 0x%02x (device id %u)", st, st >> 5);
	found = true;
	/* TODO(TODO.md 2.3): keep the calibration in settings instead of redoing it every boot. */
	calibrate();
	power_down();
	return 0;
}

int haptics_start(uint8_t intensity, uint8_t pattern, uint8_t ramp_s, uint8_t buzz_s)
{
	int err;

	/* The DRV2605L runs from raw VBAT: with a flat cell it isn't there at boot. Try again. */
	if (!found && haptics_init() != 0) {
		return -ENODEV;
	}

	gpio_pin_set_dt(&io_hapt_en, 1);
	k_msleep(1);
	/* Registers are rewritten every time: EN low (shutdown) between buzzes. */
	err = configure(!calibrated);
	err = err ?: wr(REG_RTP, 0);
	err = err ?: wr(REG_MODE, MODE_RTP);
	if (err) {
		LOG_ERR("motor driver setup failed (%d)", err);
		gpio_pin_set_dt(&io_hapt_en, 0);
		return err;
	}
	LOG_INF("buzz: drive %u, pattern %u, %u s (%s loop)", intensity, pattern, buzz_s,
		calibrated ? "closed" : "open");
	target = intensity;
	pat = pattern;
	ramp_ms = (uint32_t)ramp_s * 1000;
	total_ms = (uint32_t)buzz_s * 1000;
	elapsed_ms = 0;
	running = true;
	k_work_reschedule(&step_work, K_NO_WAIT);
	return 0;
}

void haptics_stop(void)
{
	running = false;
	k_work_cancel_delayable(&step_work);
	power_down();
}

bool haptics_busy(void)
{
	return running;
}
```

## src/led.c
```c
/*
 * IS31FL3193 (Lumissil) RGB LED driver. The chip is write-only over I2C. Power-up state: software
 * shutdown (reg 0x00 = 0x01: SSD = 1, EN = 0). Enable = write 0x20 (EN = 1, SSD = 0).
 *
 * The LED's anode (VLED) is on the BQ25125 LS/LDO output, which powers up as a 1.8 V LDO: too low
 * for the green and blue dies. pmic_led_supply() switches it to load-switch mode (VLED = PMID).
 */
#include "led.h"

#include <zephyr/kernel.h>
#include <zephyr/logging/log.h>

#include "board_io.h"
#include "pmic.h"

LOG_MODULE_REGISTER(led, LOG_LEVEL_INF);

/* 0x68 with the address pin to GND (band README); the WLCSP "D" version is fixed at 0x6B. */
static const uint8_t addrs[] = {0x68, 0x6B};
static uint8_t addr;

#define REG_SHUTDOWN 0x00
#define REG_MODE     0x02
#define REG_CURRENT  0x03
#define REG_PWM1     0x04 /* OUT1 green */
#define REG_PWM2     0x05 /* OUT2 blue */
#define REG_PWM3     0x06 /* OUT3 red */
#define REG_UPDATE   0x07
#define REG_LED_CTRL 0x1D

#define SHUTDOWN_ON  0x20 /* EN = 1 (channels on), SSD = 0 (normal operation) */
#define MODE_PWM     0x00
#define CURRENT_5MA  (0x2 << 2) /* CS bits 4:2: 000 42 mA, 001 10 mA, 010 5 mA, 011 30 mA */
#define CTRL_ALL     0x07

static int wr(uint8_t reg, uint8_t val)
{
	return i2c_reg_write_byte(i2c_bus, addr, reg, val);
}

/* Diagnostic: log every address that ACKs (a write of just the register pointer 0x00, which
 * changes nothing on the parts on this bus). Expected: 0x19, 0x5A, 0x6A (+ 0x68 LED driver). */
static void bus_scan(void)
{
	uint8_t reg = 0x00;

	for (uint8_t a = 0x08; a < 0x78; a++) {
		if (i2c_write(i2c_bus, &reg, 1, a) == 0) {
			LOG_INF("  0x%02x answers", a);
		}
	}
}

/* Wake the driver (SDB high) and find which address answers (the chip can't be read). */
static void probe(void)
{
	gpio_pin_set_dt(&io_led_en, 1);
	k_usleep(500);
	for (size_t i = 0; i < ARRAY_SIZE(addrs); i++) {
		/* Write the power-up value (software shutdown) to reg 0x00. The 0.3 probe wrote the
		 * reset register 0x2F and got no answer, while a scan writing reg 0x00 found 0x68:
		 * this part apparently refuses (NACKs) register 0x2F. */
		if (i2c_reg_write_byte(i2c_bus, addrs[i], REG_SHUTDOWN, 0x01) == 0) {
			addr = addrs[i];
			LOG_INF("IS31FL3193 at 0x%02x", addr);
			break;
		}
	}
	if (!addr) {
		LOG_ERR("IS31FL3193 not answering at 0x68 or 0x6B; I2C scan with SDB high:");
		bus_scan();
	}
	gpio_pin_set_dt(&io_led_en, 0);
}

int led_init(void)
{
	probe();
	return addr ? 0 : -ENODEV;
}

int led_set(uint8_t r, uint8_t g, uint8_t b)
{
	int err;

	if (!r && !g && !b) {
		gpio_pin_set_dt(&io_led_en, 0); /* hardware shutdown */
		return pmic_led_supply(false);
	}
	if (!addr) {
		probe();
		if (!addr) {
			return -ENODEV;
		}
	}
	err = pmic_led_supply(true);
	gpio_pin_set_dt(&io_led_en, 1);
	k_usleep(500);
	err = err ?: wr(REG_MODE, MODE_PWM);
	err = err ?: wr(REG_CURRENT, CURRENT_5MA);
	err = err ?: wr(REG_LED_CTRL, CTRL_ALL);
	err = err ?: wr(REG_PWM1, g);
	err = err ?: wr(REG_PWM2, b);
	err = err ?: wr(REG_PWM3, r);
	err = err ?: wr(REG_UPDATE, 0x00);
	err = err ?: wr(REG_SHUTDOWN, SHUTDOWN_ON);
	if (err) {
		LOG_WRN("LED write failed (%d)", err);
	}
	return err;
}
```

## src/pmic.c
```c
/*
 * BQ25125 (TI SLUSDL9; register map as the pin-compatible BQ25120A, SLUSD08). Plan, from the band
 * README:
 * - Leave it in default mode as much as possible: no I2C writes means no host-mode watchdog.
 * - /CD high only while talking to it on battery; low the rest of the time (Hi-Z, 0.7 uA) and
 *   always while docked (/CD high stops charging). I2C is off in Hi-Z.
 * - I2C writes only for: a VBMON battery reading (on battery), the LS/LDO output setting for the
 *   LED supply, ship mode (later).
 */
#include "pmic.h"

#include <zephyr/kernel.h>
#include <zephyr/logging/log.h>

#include "battery.h"
#include "board_io.h"

LOG_MODULE_REGISTER(pmic, LOG_LEVEL_INF);

#define ADDR 0x6A

#define REG_STATUS 0x00
#define REG_FAULT  0x01 /* 7 VIN_OV, 6 VIN_UV, 5 BAT_UVLO, 4 BAT_OCP (clear on read) */
#define REG_TS     0x02 /* TS control and status: TS fault bits (NTC hot/cold) */
#define REG_VBREG  0x05
#define REG_LS_LDO 0x07
#define REG_VBMON  0x0A

#define STATUS_STAT(st)  (((st) >> 6) & 0x3) /* 0 ready, 1 charging, 2 done, 3 fault */
#define VBMON_READ       BIT(7)
/*
 * LS/LDO: bit 7 EN_LS_LDO, bits 6:2 voltage code (0.8 V + 0.1 V per step). Codes above 3.3 V
 * (26-31) make it a load switch: VLED follows PMID. Leave EN_LS_LDO at 0 and switch the output
 * with LSCTRL (output on when either is set). The code may only change while the output is off.
 */
#define LS_LDO_SWITCH    (31u << 2)

static K_MUTEX_DEFINE(pmic_lock);
static uint8_t battery_pct = BATTERY_PCT_UNKNOWN;
static uint16_t battery_mv;
static bool charging;
static bool ls_mode_set;

static bool cd_high(void)
{
	if (pmic_docked()) {
		return false; /* never stop charging to talk to it; I2C works anyway with VIN */
	}
	gpio_pin_set_dt(&io_chg_cd, 1);
	k_msleep(2); /* Hi-Z to active battery takes about 1 ms */
	return true;
}

static void cd_low(void)
{
	gpio_pin_set_dt(&io_chg_cd, 0);
}

static int rd(uint8_t reg, uint8_t *val)
{
	return i2c_reg_read_byte(i2c_bus, ADDR, reg, val);
}

static int wr(uint8_t reg, uint8_t val)
{
	return i2c_reg_write_byte(i2c_bus, ADDR, reg, val);
}

int pmic_init(void)
{
	uint8_t st;
	int err;
	bool cd = cd_high();

	/* On the dock the BQ talks I2C anyway (VIN present), so this works either way. */
	uint8_t fault = 0, ts = 0;

	err = rd(REG_STATUS, &st);
	err = err ?: rd(REG_FAULT, &fault);
	err = err ?: rd(REG_TS, &ts);
	if (cd) {
		cd_low();
	}
	if (err) {
		LOG_ERR("no answer at 0x%02x (%d)", ADDR, err);
		return err;
	}
	/* /PG (DOCK_PG) is low only while VIN is good. STAT: 0 ready, 1 charging, 2 done, 3 fault. */
	LOG_INF("BQ25125 status 0x%02x (STAT %u), faults 0x%02x, TS reg 0x%02x, /PG pin %s -> %s",
		st, STATUS_STAT(st), fault, ts, pmic_docked() ? "low" : "high",
		pmic_docked() ? "docked" : "on battery");
	(void)pmic_update();
	return 0;
}

bool pmic_docked(void)
{
	return gpio_pin_get_dt(&io_dock_pg) == 1; /* active low in the devicetree */
}

int pmic_update(void)
{
	uint8_t st = 0, vbreg = 0x78, vbmon = 0;
	bool docked = pmic_docked();
	bool cd;
	int err;

	k_mutex_lock(&pmic_lock, K_FOREVER);
	cd = cd_high();
	err = rd(REG_STATUS, &st);
	charging = !err && docked && STATUS_STAT(st) == 1;
	if (!err && docked) {
		uint8_t fault = 0;

		(void)rd(REG_FAULT, &fault);
		LOG_INF("docked: status 0x%02x (STAT %u), faults 0x%02x", st, STATUS_STAT(st), fault);
	}
	/*
	 * VBMON only on battery: a reading while charging is high (the datasheet suggests pausing
	 * the charge), and on the dock we stay off I2C writes so the charger keeps its default mode.
	 * Keep the last battery reading while docked.
	 */
	if (!err && !docked) {
		(void)rd(REG_VBREG, &vbreg);
		err = wr(REG_VBMON, VBMON_READ);
		k_msleep(3); /* the reading takes 2 ms */
		err = err ?: rd(REG_VBMON, &vbmon);
	}
	if (cd) {
		cd_low();
	}
	if (!err && !docked) {
		uint16_t mv = battery_vbmon_to_mv(vbmon, battery_vbreg_to_mv(vbreg));

		if (mv) {
			battery_mv = mv;
			battery_pct = battery_mv_to_pct(mv);
		}
		LOG_INF("battery: VBMON 0x%02x, VBATREG reg 0x%02x -> %u mV, %u %%", vbmon, vbreg, mv,
			battery_pct);
	} else if (err) {
		LOG_WRN("battery read failed (%d)", err);
	}
	k_mutex_unlock(&pmic_lock);
	return err;
}

uint8_t pmic_battery_pct(void)
{
	return battery_pct;
}

uint16_t pmic_battery_mv(void)
{
	return battery_mv;
}

bool pmic_charging(void)
{
	return charging;
}

int pmic_led_supply(bool on)
{
	int err = 0;

	k_mutex_lock(&pmic_lock, K_FOREVER);
	if (!on) {
		gpio_pin_set_dt(&io_ls_ctrl, 0);
		k_mutex_unlock(&pmic_lock);
		return 0;
	}
	/*
	 * The LS/LDO output powers up as a 1.8 V LDO, too low for the LED (blue and green need about
	 * 3 V). Set the load-switch code once with the output off, then switch it with LSCTRL. In Hi-Z
	 * (/CD low) the watchdog is off and the setting stays. On the dock the write puts the charger
	 * in host mode; its watchdog returns it to defaults 50 s later, so write again each time.
	 */
	if (!ls_mode_set || pmic_docked()) {
		uint8_t back = 0;
		bool cd;

		gpio_pin_set_dt(&io_ls_ctrl, 0);
		cd = cd_high();
		err = wr(REG_LS_LDO, LS_LDO_SWITCH);
		err = err ?: rd(REG_LS_LDO, &back);
		if (cd) {
			cd_low();
		}
		if (err || (back & 0xFC) != LS_LDO_SWITCH) {
			LOG_WRN("LS/LDO setup failed (err %d, reg 0x%02x)", err, back);
		} else {
			ls_mode_set = !pmic_docked();
			LOG_INF("LED supply in load-switch mode (reg 0x07 = 0x%02x)", back);
		}
	}
	gpio_pin_set_dt(&io_ls_ctrl, 1);
	k_mutex_unlock(&pmic_lock);
	return err;
}
```

## src/pmic.h
```c
/* BQ25125 charger. Its power-up defaults already charge correctly (4.2 V, 30 mA set by R202). */
#ifndef NUDGEBAND_PMIC_H
#define NUDGEBAND_PMIC_H

#include <stdbool.h>
#include <stdint.h>

int pmic_init(void);

/* True while the dock supplies VIN (/PG low). */
bool pmic_docked(void);

/* Refresh the charging flag and (on battery) the VBMON battery reading. Call now and then. */
int pmic_update(void);

/* Battery percent (0-100) from the last VBMON reading, or 0xFF before the first one. */
uint8_t pmic_battery_pct(void);

/* Battery voltage in mV from the last VBMON reading (0 if none). */
uint16_t pmic_battery_mv(void);

/* True while docked and the charger reports a charge in progress. */
bool pmic_charging(void);

/* LED supply on/off (LS/LDO in load-switch mode). */
int pmic_led_supply(bool on);

#endif
```
